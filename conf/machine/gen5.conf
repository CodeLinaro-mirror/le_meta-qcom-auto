## conf/machine/gen5.conf
```bitbake
#@TYPE: Machine
#@NAME: gen5
#@DESCRIPTION: Machine configuration for QTI gen5 machine family

BASEMACHINE = "sa8797"
include conf/machine/include/gen5.inc

include conf/machine/include/tune-oryon-1.inc

RECOVERY_IMAGE = "0"

PREFERRED_PROVIDER_mkbootimg-native = "mkbootimg-gki-native"
PREFERRED_VERSION_mkbootimg-gki-native = "5.14"

EXTRA_IMAGEDEPENDS += "edk2"
CLANG_BIN="${SRC_DIR_ROOT}/prebuilts/clang/host/linux-x86/clang-r416183b/bin/"

KERNEL_IMAGE_HEADER_VERSION = "2"
KERNEL_BASE = "0x80000000"
KERNEL_TAGS_OFFSET = "0x1e00000"
KERNEL_CONFIG = "defconfig"
RH_KERNEL_NAME = "rh-fedora-kernel-6.9"
KERNEL_ARCH="gen5auto"

KERNEL_CMD_PARAMS = "rw rootwait console=ttyMSM0,115200,n8 firmware_class.path=/firmware/vm/boot systemd.gpt_auto=0 cgroup.memory=nokmem,nosocket qcom_scm.download_mode=1 page_owner=on rcupdate.rcu_expedited=1 rcu_nocbs=0-17 rcupdate.rcu_normal_after_boot=0 fsck.repair=yes systemd.service_watchdogs=0 driver_async_probe=scmi-hwmon pd_ignore_unused "
KERNEL_CMD_PARAMS:append = "${@bb.utils.contains('MACHINE_FEATURES', 'early-ramdisk-init', ' rdinit=/sbin/early-ramdisk-init early-ramdisk.mode=3 ', '', d)}"
KERNEL_CMD_PARAMS:remove = "${@bb.utils.contains_any('VARIANT', 'perf user', 'console=ttyMSM0,115200,n8', '', d)}"
#KERNEL_CMD_PARAMS:remove = "${@bb.utils.contains_any('VARIANT', 'perf user', 'earlycon=qcom_geni,0x884000', '', d)}"
KERNEL_CMD_PARAMS:remove = "${@bb.utils.contains('IMAGE_FEATURES', 'read-only-rootfs', 'rw', '', d)}"
KERNEL_CMD_PARAMS:remove = "${@bb.utils.contains_any('VARIANT', 'perf user', 'page_owner=on', '', d)}"
KERNEL_CMD_PARAMS:append = "${@bb.utils.contains_any('VARIANT', 'perf user', '', 'kmemleak=off ', d)}"

KERNEL_IMAGETYPE = "Image"

KERNEL_MACHINE_DTB = "\
    arch/arm64/boot/dts/qcom/sa8797p-adp-star.dtb \
    arch/arm64/boot/dts/qcom/sa8797p-non-safe-ivi-adp-star.dtb \
    arch/arm64/boot/dts/qcom/sa8797p-adp-star-pcie-ep.dtb \
    arch/arm64/boot/dts/qcom/sa8797p-qam-ride-sx-pcie-ep.dtb \
    arch/arm64/boot/dts/qcom/sa8797p-non-safe-ivi-ride-sx.dtb \
    arch/arm64/boot/dts/qcom/sa8797p-safe-ivi-ride-sx.dtb \
    arch/arm64/boot/dts/qcom/sa8797p-ride-sx.dtb \
    arch/arm64/boot/dts/qcom/sa8797p-multi-gvm-ride-sx.dtb \
    arch/arm64/boot/dts/qcom/sa8797p-non-safe-la-gvm-ride-sx.dtb \
    arch/arm64/boot/dts/qcom/sa8797p-non-safe-multi-gvm-ride-sx.dtb \
    arch/arm64/boot/dts/qcom/sa8797p-la-gvm-ride-sx.dtb \
    arch/arm64/boot/dts/qcom/sa8797p-v2-adp-star.dtb \
    arch/arm64/boot/dts/qcom/sa8797p-v2-non-safe-ivi-adp-star.dtb \
    arch/arm64/boot/dts/qcom/sa8797p-v2-non-safe-ivi-ride-sx.dtb \
    arch/arm64/boot/dts/qcom/sa8797p-v2-safe-ivi-ride-sx.dtb \
    arch/arm64/boot/dts/qcom/sa8797p-v2-ride-sx.dtb \
    arch/arm64/boot/dts/qcom/sa8x97p-qam-pats.dtb \
    arch/arm64/boot/dts/qcom/sa8x97p-safe-ivi-qam-pats.dtb \
    arch/arm64/boot/dts/qcom/sa8x97p-non-safe-ivi-qam-pats.dtb \
    arch/arm64/boot/dts/qcom/sa8x97p-flex-ride-sx.dtb \
    arch/arm64/boot/dts/qcom/sa8x97p-v2-flex-ride-sx.dtb \
    arch/arm64/boot/dts/qcom/sa8x97p-v2-adp-star-pcie-ep.dtb \
    arch/arm64/boot/dts/qcom/sa8x97p-v2-ride-sx-pcie-ep.dtb \
    arch/arm64/boot/dts/qcom/sa8x97p-v2-flex-adp-star.dtb \
    arch/arm64/boot/dts/qcom/seca-rumi.dtb \
    arch/arm64/boot/dts/qcom/seca-adas-ride-sx.dtb \
    arch/arm64/boot/dts/qcom/seca-flex-ride-sx.dtb \
    arch/arm64/boot/dts/qcom/seca-non-safe-ivi-adp-star.dtb \
    arch/arm64/boot/dts/qcom/seca-non-safe-ivi-ride-sx.dtb \
    arch/arm64/boot/dts/qcom/seca-safe-ivi-ride-sx.dtb \
    arch/arm64/boot/dts/qcom/seca-adas-pats.dtb \
    arch/arm64/boot/dts/qcom/seca-non-safe-ivi-pats.dtb \
    arch/arm64/boot/dts/qcom/seca-safe-ivi-pats.dtb \
    arch/arm64/boot/dts/qcom/seca-qam-star-pcie-ep.dtb \
    arch/arm64/boot/dts/qcom/seca-qam-ride-sx-pcie-ep.dtb \
"

OOT_DTBS = "\
    arch/arm64/boot/dts/qcom/sa8797p-overlay.dtbo \
    arch/arm64/boot/dts/qcom/seca-overlay.dtbo \
"

OOT_DDR_DTBOS = "arch/arm64/boot/dts/qcom/sa8797p-ddr-32gb_overlay.dtbo \
                 arch/arm64/boot/dts/qcom/sa8797p-ddr-48gb_overlay.dtbo \
                 arch/arm64/boot/dts/qcom/sa8797p-ddr-64gb_overlay.dtbo \
                 arch/arm64/boot/dts/qcom/sa8x97p-flex-ddr-32gb_overlay.dtbo \
                 arch/arm64/boot/dts/qcom/sa8x97p-flex-ddr-48gb_overlay.dtbo \
                 arch/arm64/boot/dts/qcom/sa8x97p-flex-ddr-64gb_overlay.dtbo"


# Only modules that exist as installable packages for this kernel.
# Most are RPROVIDED by safelinux-cfg-modules (OOT DLKMs); vfio-platform-base
# and vfio-platform are genuine =m in-tree modules required by vfio-device-bind.
# Matches QLI-2.0-AUTO / CL 6776705. Other drivers (aquantia, gunyah, ufshcd,
# qcom-geni-se, etc.) are =y built-in or OOT-incompatible -- no IPK available.
EARLY_RAMDISK_KERNEL_MODULES = "\
    kernel-module-kiumd-${KERNEL_VERSION} \
    kernel-module-iommu-iova-map-${KERNEL_VERSION} \
    kernel-module-scm-user-intf-${KERNEL_VERSION} \
    kernel-module-vfio-platform-base-${KERNEL_VERSION} \
    kernel-module-vfio-platform-${KERNEL_VERSION} \
    kernel-module-kiumd-kgsl-${KERNEL_VERSION} \
    kernel-module-vfio-iommu-qcom-${KERNEL_VERSION} \
    kernel-module-qcom-dload-mode-${KERNEL_VERSION} \
    kernel-module-qcom-uscmi-${KERNEL_VERSION} \
    kernel-module-arm-smmu-qcom-fusa-${KERNEL_VERSION} \
    kernel-module-pinctrl-fusa-${KERNEL_VERSION} \
    kernel-module-vendor-uscmi-${KERNEL_VERSION} \
"

RUSTVERSION = "1.75%"
```
